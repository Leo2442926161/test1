## CMakeLists.txt
```
# nRF54L15 application skeleton. Not an EVT flash image.
cmake_minimum_required(VERSION 3.20.0)

find_package(Zephyr REQUIRED HINTS $ENV{ZEPHYR_BASE})
project(chaoji_smoke_nrf_skeleton LANGUAGES C)

# Host behavior, ICD v0.1.7. The host CLI is not a source.
set(FW_DIR ${CMAKE_CURRENT_LIST_DIR}/..)

target_sources(app PRIVATE
	src/main.c
	src/hook_session.c
	${FW_DIR}/src/fw_node.c
	${FW_DIR}/src/fw_ux.c
	${FW_DIR}/src/fw_status.c
)

target_include_directories(app PRIVATE
	${CMAKE_CURRENT_LIST_DIR}/include
	${FW_DIR}/include
)
```

## Kconfig
```
# Application Kconfig. EVT image claim stays off.

menu "Zephyr"
source "Kconfig.zephyr"
endmenu

config CHAOJI_SMOKE_EVT_IMAGE
	bool "Produce the EVT flash image"
	default n
	help
	  Leave disabled. The application links fw_node, fw_ux, and fw_status
	  and can print their JSON on the DK console, but RTT is not linked,
	  UART_DBG is still PIN_TBD, and no west image is checked in.
	  main.c refuses to compile when this symbol is set.
```

## west.yml
```
# Workspace manifest for the nRF54L15 skeleton.
# west update clones nRF Connect SDK; this repository does not vendor it.
# Revision checked 2026-10-22 against github.com/nrfconnect/sdk-nrf releases:
# v3.4.1 (published 2026-09-17). Not an EVT flash image.

manifest:
  self:
    path: test1

  remotes:
    - name: ncs
      url-base: https://github.com/nrfconnect

  projects:
    - name: nrf
      remote: ncs
      repo-path: sdk-nrf
      revision: v3.4.1
      import: true
```

## prj.conf
```kconfig
# DK toolchain smoke. Behavior objects link; this is still not an EVT image.
CONFIG_PRINTK=y
CONFIG_SERIAL=y
CONFIG_CONSOLE=y
CONFIG_UART_CONSOLE=y

# Console printk is the debug view of the hook JSON.
# CONFIG_USE_SEGGER_RTT is not set
# CONFIG_SETTINGS is not set
# CONFIG_CHAOJI_SMOKE_EVT_IMAGE is not set
```

## app.overlay
```dts
/*
 * Auto-loaded by Zephyr for the DK smoke build. Assigns no pins.
 * The five draft binds (four lamp pins + VBAT AIN2) are only in
 * boards/evt_pins_placeholder.overlay, which this build does not select.
 * UART_DBG and every other net stay PIN_TBD. See HARDWARE_NEEDED.md.
 */
/ {
};
```

## src/main.c
```c
/*
 * DK smoke entry. Links the ICD hook session and prints it on the console.
 * This is not an EVT image: no pins, no RTT channel, no UART_DBG, no hex.
 */
#include "hook_session.h"

#include <string.h>

#include <zephyr/kernel.h>
#include <zephyr/sys/printk.h>

#if IS_ENABLED(CONFIG_CHAOJI_SMOKE_EVT_IMAGE)
#error "EVT flash image refused. No in-tree hex, UART_DBG is PIN_TBD, RTT write is not linked. See HARDWARE_NEEDED.md."
#endif

#define HOOK_LINE_MAX 2048
#define HOOK_CHUNK 64

static char hook_line[HOOK_LINE_MAX];

static void console_chunk(const char *payload, size_t n)
{
	char chunk[HOOK_CHUNK + 1];
	size_t off;

	for (off = 0; off < n; off += HOOK_CHUNK) {
		size_t take = n - off;

		if (take > HOOK_CHUNK) {
			take = HOOK_CHUNK;
		}
		memcpy(chunk, payload + off, take);
		chunk[take] = '\0';
		printk("HOOK_JSON %s\n", chunk);
	}
}

int main(void)
{
	size_t framed = 0;
	size_t json_len;

	hook_session_boot();
	printk("hook_meta sink=%s rtt=%s uart=%s relay_store=%s image_claim=%s\n",
	       hook_session_sink_name(hook_session_active_sink()),
	       hook_session_rtt_status(), hook_session_uart_status(),
	       hook_session_relay_store_name(), hook_session_image_claim());
	printk("hook_rtt_write=%d hook_uart_write=%d rtt_channel_plan=%d uart_baud_plan=%d\n",
	       hook_rtt_write(hook_line, 0), hook_uart_write(hook_line, 0),
	       HOOK_RTT_CHANNEL_PLAN, HOOK_UART_BAUD_PLAN);

	if (hook_session_json(hook_line, sizeof(hook_line)) != 0) {
		printk("hook_json error\n");
		return 0;
	}
	json_len = strlen(hook_line);
	printk("HOOK_JSON_BEGIN bytes=%u\n", (unsigned)json_len);
	console_chunk(hook_line, json_len);
	printk("HOOK_JSON_END\n");

	if (hook_session_frame(hook_line, sizeof(hook_line), &framed) != 0) {
		printk("hook_frame error\n");
		return 0;
	}
	/*
	 * The frame is the byte contract for a future RTT or UART sink.
	 * Both writers refuse it. Do not treat a 0 return as success.
	 */
	printk("hook_frame_bytes=%u hook_frame_rtt=%d hook_frame_uart=%d\n",
	       (unsigned)framed, hook_rtt_write(hook_line, framed),
	       hook_uart_write(hook_line, framed));
	return 0;
}
```

## include/hook_session.h
```c
/*
 * On-device session in front of fw_node / fw_status.
 * Not an EVT flash image. fw_sim.c stays on the host.
 *
 * The JSON object is fw_status_json() unchanged, so the line still says
 * image=host-sim and ncs_board_build=false. That string lives in the hashed
 * host source. This session does not rewrite it into a flash identity.
 */
#ifndef HOOK_SESSION_H
#define HOOK_SESSION_H

#include "fw.h"

#include <stdbool.h>
#include <stddef.h>

/* Future Zephyr settings key. CONFIG_SETTINGS is off; nothing is stored. */
#define HOOK_RELAY_SETTINGS_KEY "chaoji/relay_enable"

/*
 * Planned SEGGER RTT channel for the hook frame. Channel 0 stays logs.
 * The channel is not opened. hook_rtt_write() returns -1.
 */
#define HOOK_RTT_CHANNEL_PLAN 1

/*
 * UART_DBG baud is not chosen. HARDWARE_NEEDED.md leaves it blank.
 * 0 means "unlocked", not a real baud. hook_uart_write() returns -1.
 */
#define HOOK_UART_BAUD_PLAN 0

typedef enum hook_sink {
	HOOK_SINK_NONE = 0,
	HOOK_SINK_CONSOLE = 1, /* DK printk only. Not the production test port. */
	HOOK_SINK_RTT = 2,
	HOOK_SINK_UART = 3
} hook_sink_t;

void hook_session_boot(void);
fw_node_t *hook_session_node(void);

/* One fw_status_json object, no newline. Peer is NULL (one node, no radio). */
int hook_session_json(char *buf, size_t buflen);

/*
 * Production framing once a sink accepts bytes: the JSON object plus one
 * trailing '\n' and no other newline. out_len counts the newline, not the NUL.
 */
int hook_session_frame(char *buf, size_t buflen, size_t *out_len);

/* Active view until RTT is linked. */
hook_sink_t hook_session_active_sink(void);
const char *hook_session_sink_name(hook_sink_t sink);

/* "not_linked" until CONFIG_USE_SEGGER_RTT exists and a west image links it. */
const char *hook_session_rtt_status(void);
/* "pin_tbd" until UART_DBG leaves PIN_TBD in HARDWARE_NEEDED.md. */
const char *hook_session_uart_status(void);

/* "none" until a real west build of an EVT board is the flash identity. */
const char *hook_session_image_claim(void);

/* RAM mirror only. Boot always runs fw_node_init(), so the default is true. */
const char *hook_session_relay_store_name(void);
bool hook_session_relay_persisted(void);
int hook_session_set_relay_enable(bool enable);

/*
 * Sinks. Return 0 only if the bytes were accepted by that port.
 * Both return -1 in this tree. They do not write the console.
 */
int hook_rtt_write(const char *bytes, size_t len);
int hook_uart_write(const char *bytes, size_t len);

#endif
```

## src/hook_session.c
```c
#include "hook_session.h"

#include <string.h>

static fw_node_t g_node;
static bool g_booted;

void hook_session_boot(void)
{
	fw_node_init(&g_node);
	g_booted = true;
}

fw_node_t *hook_session_node(void)
{
	if (!g_booted) {
		hook_session_boot();
	}
	return &g_node;
}

int hook_session_json(char *buf, size_t buflen)
{
	return fw_status_json(hook_session_node(), NULL, buf, buflen);
}

int hook_session_frame(char *buf, size_t buflen, size_t *out_len)
{
	size_t n;

	if (buf == NULL || out_len == NULL || buflen < 3) {
		return -1;
	}
	if (hook_session_json(buf, buflen - 1) != 0) {
		return -1;
	}
	n = strlen(buf);
	if (n == 0 || n + 2 > buflen) {
		return -1;
	}
	if (memchr(buf, '\n', n) != NULL || memchr(buf, '\r', n) != NULL) {
		return -1;
	}
	buf[n] = '\n';
	buf[n + 1] = '\0';
	*out_len = n + 1;
	return 0;
}

hook_sink_t hook_session_active_sink(void)
{
	return HOOK_SINK_CONSOLE;
}

const char *hook_session_sink_name(hook_sink_t sink)
{
	switch (sink) {
	case HOOK_SINK_CONSOLE:
		return "console";
	case HOOK_SINK_RTT:
		return "rtt";
	case HOOK_SINK_UART:
		return "uart";
	case HOOK_SINK_NONE:
	default:
		return "none";
	}
}

const char *hook_session_rtt_status(void)
{
	return "not_linked";
}

const char *hook_session_uart_status(void)
{
	return "pin_tbd";
}

const char *hook_session_image_claim(void)
{
	return "none";
}

const char *hook_session_relay_store_name(void)
{
	return "ram";
}

bool hook_session_relay_persisted(void)
{
	return false;
}

int hook_session_set_relay_enable(bool enable)
{
	fw_nvs_set_relay_enable(hook_session_node(), enable);
	return 0;
}

int hook_rtt_write(const char *bytes, size_t len)
{
	(void)bytes;
	(void)len;
	return -1;
}

int hook_uart_write(const char *bytes, size_t len)
{
	(void)bytes;
	(void)len;
	return -1;
}
```
